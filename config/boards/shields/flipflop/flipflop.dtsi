/ {
    chosen {
        zmk,kscan = &default_transform;
    };



     default_transform: kscan_transform {
        compatible = "zmk,kscan-transform";
        kscan = <&default_matrix>;

        // mapeamento físico → lógico
        map = <
               /* left half (0–29) */
               0 1 2 3 4 5
               6 7 8 9 10 11
               12 13 14 15 16 17
               18 19 20 21 22 23
               24 25 26 27 28 29

               /* right half (espelhado) */
               35 34 33 32 31 30
               41 40 39 38 37 36
               47 46 45 44 43 42
               53 52 51 50 49 48
               59 58 57 56 55 54>;
    };

    default_matrix: kscan_matrix {
        compatible = "zmk,kscan-gpio-matrix";
        wakeup-source;

        diode-direction = "col2row";

        // total lógico
        rows = <5>;
        columns = <6>;


        row-gpios = <&pro_micro 21 (GPIO_ACTIVE_HIGH | GPIO_PULL_DOWN)>, // Row A from the schematic file
                    <&pro_micro 20 (GPIO_ACTIVE_HIGH | GPIO_PULL_DOWN)>, // Row B from the schematic file
                    <&pro_micro 19 (GPIO_ACTIVE_HIGH | GPIO_PULL_DOWN)>, // Row C from the schematic file
                    <&pro_micro 18 (GPIO_ACTIVE_HIGH | GPIO_PULL_DOWN)>, // Row D from the schematic file
                    <&pro_micro 15 (GPIO_ACTIVE_HIGH | GPIO_PULL_DOWN)>; // Row E from the schematic file

        col-gpios = <&pro_micro 14 GPIO_ACTIVE_HIGH>,
                    <&pro_micro 16 GPIO_ACTIVE_HIGH>,
                    <&pro_micro 10 GPIO_ACTIVE_HIGH>,
                    <&pro_micro 7 GPIO_ACTIVE_HIGH>,
                    <&pro_micro 8 GPIO_ACTIVE_HIGH>,
                    <&pro_micro 9 GPIO_ACTIVE_HIGH>;
    };
};
