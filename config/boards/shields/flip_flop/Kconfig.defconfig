## config/boards/shields/flip_flop/Kconfig.defconfig
```kconfig
if SHIELD_FLIP_FLOP_LEFT

# Name must be less than 16 characters long!
config ZMK_KEYBOARD_NAME
    default "FlipFlop Keyboard"

config ZMK_SPLIT_ROLE_CENTRAL
    default y

endif

if SHIELD_FLIP_FLOP_LEFT || SHIELD_FLIP_FLOP_RIGHT

config ZMK_SPLIT
    default y

endif
```

## config/boards/shields/flip_flop/Kconfig.shield
```kconfig
config SHIELD_FLIP_FLOP_LEFT
    def_bool $(shields_list_contains,flip_flop_left)

config SHIELD_FLIP_FLOP_RIGHT
    def_bool $(shields_list_contains,flip_flop_right)
```

## config/boards/shields/flipflop/Kconfig.defconfig
```kconfig
if SHIELD_FLIPFLOP_LEFT

config ZMK_KEYBOARD_NAME
    default "Flipflop"

config ZMK_SPLIT_ROLE_CENTRAL
    default y

endif

if SHIELD_FLIPFLOP_LEFT || SHIELD_FLIPFLOP_RIGHT

config ZMK_SPLIT
    default y

endif
```

## config/boards/shields/flipflop/Kconfig.shield
```kconfig
config SHIELD_FLIPFLOP_LEFT
    def_bool $(shields_list_contains,flipflop_left)

config SHIELD_FLIPFLOP_RIGHT
    def_bool $(shields_list_contains,flipflop_right)
```
